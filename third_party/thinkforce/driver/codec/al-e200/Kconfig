## third_party/thinkforce/driver/codec/al-e200/Kconfig
```kconfig
config TF_ENCODER
       tristate "Think-force Video Encoder Support."
       default y
```

## third_party/thinkforce/driver/codec/v5xx-3/Kconfig
```kconfig
config MALI_VPU3_DEBUG
	depends on MALI_VPU3
	bool "Mali VPU driver debug"
	default n
	help
		This enabled debug output for the Mali VPU driver

config CONFIG_MALI_VPU3_ENABLE_ALOG
	depends on MALI_VPU3
	bool "Send kernel space logs to Android logd socket."
	default n
	help
		Send kernel space logs to Android logd socket. This option should only be enabled for Android Lollipop or later revisions.

config CONFIG_MALI_VPU3_ENABLE_FTRACE
	depends on MALI_VPU3
	bool "Send kernel space logs to ftrace."
	default n
	help
		Send kernel space logs to ftrace.

config CONFIG_MALI_VPU3_ENABLE_PRINT_FILE
	depends on MALI_VPU3
	bool "Append file and line number to kernel space log messages."
	default n
	help
		Append file and line number to kernel space log messages.

choice
	depends on MALI_VPU3
	prompt "Choose power saving mode"
config MALI_VPU3_POWER_SAVING_MODE_DVFS
	bool "Use DVFS"
config MALI_VPU3_POWER_SAVING_MODE_CLOCK_GATING
	bool "Use HW clock gating"
endchoice

choice
	depends on MALI_VPU3
	prompt "Choose hardware platform"
config MALI_VPU3_VEX6
	bool "Versatile Express 6"
config MALI_VPU3_VEX7
	bool "Versatile Express 7"
config MALI_VPU3_JUNO
	bool "Juno"
endchoice

config MALI_VPU3_DISABLE_WATCHDOG
	depends on MALI_VPU3
	bool "Disable the watchdog"
	default n
	help
		Disable the watchdog that detects frozen video sessions.
```

## third_party/thinkforce/driver/codec/v5xx-3/v5xx/Kconfig
```kconfig
menuconfig MALI_VPU
	tristate "Mali VPU driver"
	help
            This enables the Mali VPU driver

config MALI_VPU_DEBUG
	depends on MALI_VPU
	bool "Mali VPU driver debug"
	default n
	help
		This enabled debug output for the Mali VPU driver

config CONFIG_MALI_VPU_ENABLE_ALOG
	depends on MALI_VPU
	bool "Send kernel space logs to Android logd socket."
	default n
	help
		Send kernel space logs to Android logd socket. This option should only be enabled for Android Lollipop or later revisions.

config CONFIG_MALI_VPU_ENABLE_FTRACE
	depends on MALI_VPU
	bool "Send kernel space logs to ftrace."
	default n
	help
		Send kernel space logs to ftrace.

config CONFIG_MALI_VPU_ENABLE_PRINT_FILE
	depends on MALI_VPU
	bool "Append file and line number to kernel space log messages."
	default n
	help
		Append file and line number to kernel space log messages.

choice
	depends on MALI_VPU
	prompt "Choose power saving mode"
config MALI_VPU_POWER_SAVING_MODE_DVFS
	bool "Use DVFS"
config MALI_VPU_POWER_SAVING_MODE_CLOCK_GATING
	bool "Use HW clock gating"
endchoice

choice
	depends on MALI_VPU
	prompt "Choose hardware platform"
config MALI_VPU_VEX6
	bool "Versatile Express 6"
config MALI_VPU_VEX7
	bool "Versatile Express 7"
config MALI_VPU_JUNO
	bool "Juno"
endchoice

config MALI_VPU_DISABLE_WATCHDOG
	depends on MALI_VPU
	bool "Disable the watchdog"
	default n
	help
		Disable the watchdog that detects frozen video sessions.
```

## third_party/thinkforce/driver/codec/v5xx-6/Kconfig
```kconfig
config MALI_VPU6_DEBUG
	depends on MALI_VPU6
	bool "Mali VPU driver debug"
	default n
	help
		This enabled debug output for the Mali VPU driver

config CONFIG_MALI_VPU6_ENABLE_ALOG
	depends on MALI_VPU6
	bool "Send kernel space logs to Android logd socket."
	default n
	help
		Send kernel space logs to Android logd socket. This option should only be enabled for Android Lollipop or later revisions.

config CONFIG_MALI_VPU6_ENABLE_FTRACE
	depends on MALI_VPU6
	bool "Send kernel space logs to ftrace."
	default n
	help
		Send kernel space logs to ftrace.

config CONFIG_MALI_VPU6_ENABLE_PRINT_FILE
	depends on MALI_VPU6
	bool "Append file and line number to kernel space log messages."
	default n
	help
		Append file and line number to kernel space log messages.

choice
	depends on MALI_VPU6
	prompt "Choose power saving mode"
config MALI_VPU6_POWER_SAVING_MODE_DVFS
	bool "Use DVFS"
config MALI_VPU6_POWER_SAVING_MODE_CLOCK_GATING
	bool "Use HW clock gating"
endchoice

choice
	depends on MALI_VPU6
	prompt "Choose hardware platform"
config MALI_VPU6_VEX6
	bool "Versatile Express 6"
config MALI_VPU6_VEX7
	bool "Versatile Express 7"
config MALI_VPU6_JUNO
	bool "Juno"
endchoice

config MALI_VPU6_DISABLE_WATCHDOG
	depends on MALI_VPU6
	bool "Disable the watchdog"
	default n
	help
		Disable the watchdog that detects frozen video sessions.
```
